## main/Kconfig.projbuild
```kconfig
menu "ePaper Display DEMO Configuration"

config EPD_MODULE_B
    bool "2.9\" e-Paper Module (B) - Tricolor (red/black/white)"
    default y
    help
        Select if using the Waveshare 2.9inch e-Paper Module (B) with
        red/black/white tricolor display (SSD1680). The default Module
        is black/white only (SSD1608).

config EPD_2IN9B_V4
    bool "Module B V4 (newer hardware - try if V3 shows blobs)"
    depends on EPD_MODULE_B
    default n
    help
        Use V4 init sequence. Check label on back of display - V4 uses
        different commands. Try this if you get random blinks/blobs.

choice
    prompt "Display update LUT (0x22 value)"
    depends on EPD_MODULE_B
    default EPD_2IN9B_LUT_F4
    help
        LUT controls refresh waveform. Content may appear first, then
        extra phases cause black/white flashing. Try F4 or C7 to reduce.

config EPD_2IN9B_LUT_F4
    bool "0xF4 (Adafruit default - fewer phases)"
config EPD_2IN9B_LUT_C7
    bool "0xC7 (alternate)"
config EPD_2IN9B_LUT_F7
    bool "0xF7 (GxEPD2 full refresh)"
endchoice

config EPD_2IN9B_SKIP_CLEAR
    bool "Skip clear at boot (one less refresh flash)"
    depends on EPD_MODULE_B
    default y
    help
        Do not run full clear before first content. Reduces boot flashing.

config SPIFFS_BASE_ADDR
    hex "SPIFFS Base address"
    range 0x100000 0x1FFE000
    default 0x180000
    help
	Starting address of the SPIFFS area in ESP32 Flash
	Write the address in hex format, 0x180000

config SPIFFS_SIZE
    int "SPIFFS Size in bytes"
    range 262144 2097152
    default 1048576

config SPIFFS_LOG_BLOCK_SIZE
    int "SPIFFS Logical block size"
    range 4098 65536
    default 8192

config SPIFFS_LOG_PAGE_SIZE
    int "SPIFFS Logical page size"
    range 256 2048
    default 256
    help
	Set it to the phisycal page size og the used SPI Flash chip.

config EXAMPLE_USE_WIFI
    bool "Use wifi in TFT Demo"
    default n
    help
        If WiFi is used ntp server will be used to provide the exact time
        and file timestamps will be correct.
config WIFI_SSID
    string "WiFi SSID"
   	depends on EXAMPLE_USE_WIFI
    default "myssid"
    help
	SSID (network name) for the demo to connect to.

config WIFI_PASSWORD
    string "WiFi Password"
   	depends on EXAMPLE_USE_WIFI
    default "mypassword"
    help
	WiFi password (WPA or WPA2) for the demo to use.


endmenu
```
